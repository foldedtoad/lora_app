## boards/arm/nrf52_pca10040_raw/Kconfig.board
```kconfig
# nRF52 PCA10040 Raw board configuration

# Copyright (c) 2016 Nordic Semiconductor ASA
# SPDX-License-Identifier: Apache-2.0

config BOARD_NRF52_PCA10040_RAW
	bool "nRF52 PCA10040 Raw"
	depends on SOC_NRF52832_QFAA
```
